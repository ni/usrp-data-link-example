# 0 "/home/wfife/hdd/repos/rfnoc-oot-blocks-dev/build-fpga/build-x420_1000_aurora_C2_UHD_4.10/device_tree.dts"
# 0 "<built-in>"
# 0 "<command-line>"
# 1 "/home/wfife/hdd/repos/rfnoc-oot-blocks-dev/build-fpga/build-x420_1000_aurora_C2_UHD_4.10/device_tree.dts"
/*
 * Copyright 2023 Ettus Research, a National Instruments Brand
 *
 * SPDX-License-Identifier: LGPL-3.0-or-later
 * 
 * This file was automatically generated by the RFNoC image builder tool.
 * Re-running that tool will overwrite this file!
 */

/dts-v1/;
/plugin/;

# 1 "/home/wfife/hdd/repos/rfnoc-oot-blocks-dev/build-fpga/build-x420_1000_aurora_C2_UHD_4.10/x420-version-info.dtsi" 1
// mpm_version fpga_current_version 11.0.0
// mpm_version fpga_oldest_compatible_version 11.0.0
// mpm_version fpga_version_last_modified_time 0x26022715
// mpm_version cpld_ifc_current_version 2.0.0
// mpm_version cpld_ifc_oldest_compatible_version 2.0.0
// mpm_version cpld_ifc_version_last_modified_time 0x21011809
// mpm_version db_gpio_ifc_current_version 1.1.0
// mpm_version db_gpio_ifc_oldest_compatible_version 1.1.0
// mpm_version db_gpio_ifc_version_last_modified_time 0x25060315
// mpm_version rf_core_full_current_version 1.1.0
// mpm_version rf_core_full_oldest_compatible_version 1.1.0
// mpm_version rf_core_full_version_last_modified_time 0x24080915
// mpm_version rf_core_1000m_current_version 2.0.0
// mpm_version rf_core_1000m_oldest_compatible_version 2.0.0
// mpm_version rf_core_1000m_version_last_modified_time 0x25120310
# 14 "/home/wfife/hdd/repos/rfnoc-oot-blocks-dev/build-fpga/build-x420_1000_aurora_C2_UHD_4.10/device_tree.dts" 2

# 1 "/home/wfife/hdd/repos/uhddev/ettus3/fpga/usrp3/top/x400/dts/x420-fpga.dtsi" 1
/*
 * Copyright 2026 Ettus Research, a National Instruments Brand
 *
 * SPDX-License-Identifier: LGPL-3.0-or-later
 */

&fpga_full {
 firmware-name = "x420.bin";
};
# 16 "/home/wfife/hdd/repos/rfnoc-oot-blocks-dev/build-fpga/build-x420_1000_aurora_C2_UHD_4.10/device_tree.dts" 2

# 1 "/home/wfife/hdd/repos/uhddev/ettus3/fpga/usrp3/top/x400/dts/x4xx-common.dtsi" 1
/*
 * Copyright 2021 Ettus Research, a National Instruments Brand
 *
 * SPDX-License-Identifier: LGPL-3.0-or-later
 */

&fpga_full {
 #address-cells = <2>;
 #size-cells = <2>;
 uio@1000080000 {
  compatible = "usrp-uio";
  reg = <0x10 0x00080000 0x0 0x20000>;
  reg-names = "ctrlport-mboard-regs";
  status = "okay";
 };
 uio@10000A0000 {
  compatible = "usrp-uio";
  reg = <0x10 0x000A0000 0x0 0x4000>;
  reg-names = "mboard-regs";
  status = "okay";
 };
};
# 18 "/home/wfife/hdd/repos/rfnoc-oot-blocks-dev/build-fpga/build-x420_1000_aurora_C2_UHD_4.10/device_tree.dts" 2

# 1 "/home/wfife/hdd/repos/uhddev/ettus3/fpga/usrp3/top/x400/dts/x420-rfdc.dtsi" 1
/*
 * Copyright 2026 Ettus Research, a National Instruments Brand
 *
 * SPDX-License-Identifier: LGPL-3.0-or-later
 */

&fpga_full {
 #address-cells = <2>;
 #size-cells = <2>;

 misc_clk_1: misc_clk_1 {
  #clock-cells = <0>;
  clock-frequency = <40000000>;
  compatible = "fixed-clock";
 };

 misc_clk_2: misc_clk_2 {
  #clock-cells = <0>;
  clock-frequency = <184320000>;
  compatible = "fixed-clock";
 };

 rf_data_converter: usp_rf_data_converter@1000100000 {
  clock-names = "s_axi_aclk", "m0_axis_aclk", "m1_axis_aclk", "m2_axis_aclk", "m3_axis_aclk", "s0_axis_aclk", "s1_axis_aclk";
  clocks = <&misc_clk_1>, <&misc_clk_2>, <&misc_clk_2>, <&misc_clk_2>, <&misc_clk_2>, <&misc_clk_2>, <&misc_clk_2>;
  compatible = "xlnx,usp-rf-data-converter-2.1";
  num-insts = <0x1>;
  param-list = [ 00 00 00 00 00 10 00 10 00 00 00 00 01 00 00 00 00 00 00 00 00 00 00 00 01 00 00 00 01 00 00 00 00 00 00 00 01 00 00 00 01 00 00 00 0f d6 ff 39 cc 97 07 40 0a d7 a3 70 3d 0a 67 40 0a d7 a3 70 3d 0a 67 40 30 00 00 00 03 00 00 00 01 00 00 00 00 00 00 00 9e ef a7 c6 4b 37 1a 40 04 00 00 00 01 00 00 00 00 00 00 00 00 00 00 00 00 00 00 00 01 00 00 00 00 00 00 00 00 00 00 00 00 00 00 00 01 00 00 00 00 00 00 00 00 00 00 00 00 00 00 00 01 00 00 00 00 00 00 00 00 00 00 00 00 00 00 00 00 00 00 00 10 00 00 00 02 00 00 00 00 00 00 00 00 00 00 00 02 00 00 00 00 00 00 00 10 00 00 00 02 00 00 00 00 00 00 00 00 00 00 00 02 00 00 00 00 00 00 00 10 00 00 00 02 00 00 00 00 00 00 00 00 00 00 00 02 00 00 00 00 00 00 00 10 00 00 00 02 00 00 00 00 00 00 00 00 00 00 00 02 00 00 00 01 00 00 00 01 00 00 00 0f d6 ff 39 cc 97 07 40 0a d7 a3 70 3d 0a 67 40 0a d7 a3 70 3d 0a 67 40 30 00 00 00 03 00 00 00 01 00 00 00 00 00 00 00 9e ef a7 c6 4b 37 1a 40 04 00 00 00 01 00 00 00 00 00 00 00 00 00 00 00 00 00 00 00 01 00 00 00 00 00 00 00 00 00 00 00 00 00 00 00 01 00 00 00 00 00 00 00 00 00 00 00 00 00 00 00 01 00 00 00 00 00 00 00 00 00 00 00 00 00 00 00 00 00 00 00 10 00 00 00 02 00 00 00 00 00 00 00 00 00 00 00 02 00 00 00 00 00 00 00 10 00 00 00 02 00 00 00 00 00 00 00 00 00 00 00 02 00 00 00 00 00 00 00 10 00 00 00 02 00 00 00 00 00 00 00 00 00 00 00 02 00 00 00 00 00 00 00 10 00 00 00 02 00 00 00 00 00 00 00 00 00 00 00 02 00 00 00 00 00 00 00 00 00 00 00 9a 99 99 99 99 99 19 40 00 00 00 00 00 00 b9 40 00 00 00 00 00 00 00 00 0a 00 00 00 02 00 00 00 01 00 00 00 00 00 00 00 9e ef a7 c6 4b 37 1a 40 00 00 00 00 00 00 00 00 00 00 00 00 02 00 00 00 00 00 00 00 00 00 00 00 00 00 00 00 02 00 00 00 00 00 00 00 00 00 00 00 00 00 00 00 02 00 00 00 00 00 00 00 00 00 00 00 00 00 00 00 02 00 00 00 00 00 00 00 00 00 00 00 10 00 00 00 00 00 00 00 00 00 00 00 00 00 00 00 03 00 00 00 00 00 00 00 10 00 00 00 00 00 00 00 00 00 00 00 00 00 00 00 03 00 00 00 00 00 00 00 10 00 00 00 00 00 00 00 00 00 00 00 00 00 00 00 03 00 00 00 00 00 00 00 10 00 00 00 00 00 00 00 00 00 00 00 00 00 00 00 03 00 00 00 00 00 00 00 00 00 00 00 9a 99 99 99 99 99 19 40 00 00 00 00 00 00 b9 40 00 00 00 00 00 00 00 00 0a 00 00 00 02 00 00 00 01 00 00 00 00 00 00 00 9e ef a7 c6 4b 37 1a 40 00 00 00 00 00 00 00 00 00 00 00 00 02 00 00 00 00 00 00 00 00 00 00 00 00 00 00 00 02 00 00 00 00 00 00 00 00 00 00 00 00 00 00 00 02 00 00 00 00 00 00 00 00 00 00 00 00 00 00 00 02 00 00 00 00 00 00 00 00 00 00 00 10 00 00 00 00 00 00 00 00 00 00 00 00 00 00 00 03 00 00 00 00 00 00 00 10 00 00 00 00 00 00 00 00 00 00 00 00 00 00 00 03 00 00 00 00 00 00 00 10 00 00 00 00 00 00 00 00 00 00 00 00 00 00 00 03 00 00 00 00 00 00 00 10 00 00 00 00 00 00 00 00 00 00 00 00 00 00 00 03 00 00 00 01 00 00 00 01 00 00 00 0f d6 ff 39 cc 97 07 40 0a d7 a3 70 3d 0a 77 40 0a d7 a3 70 3d 0a 67 40 18 00 00 00 03 00 00 00 01 00 00 00 00 00 00 00 fc a9 f1 d2 4d 62 10 40 02 00 00 00 01 00 00 00 00 00 00 00 01 00 00 00 00 00 00 00 01 00 00 00 00 00 00 00 01 00 00 00 00 00 00 00 01 00 00 00 08 00 00 00 02 00 00 00 00 00 00 00 02 00 00 00 01 00 00 00 08 00 00 00 02 00 00 00 00 00 00 00 02 00 00 00 01 00 00 00 08 00 00 00 02 00 00 00 00 00 00 00 02 00 00 00 01 00 00 00 08 00 00 00 02 00 00 00 00 00 00 00 02 00 00 00 01 00 00 00 01 00 00 00 0f d6 ff 39 cc 97 07 40 0a d7 a3 70 3d 0a 77 40 0a d7 a3 70 3d 0a 67 40 18 00 00 00 03 00 00 00 01 00 00 00 00 00 00 00 fc a9 f1 d2 4d 62 10 40 02 00 00 00 01 00 00 00 00 00 00 00 01 00 00 00 00 00 00 00 01 00 00 00 00 00 00 00 01 00 00 00 00 00 00 00 01 00 00 00 08 00 00 00 02 00 00 00 00 00 00 00 02 00 00 00 01 00 00 00 08 00 00 00 02 00 00 00 00 00 00 00 02 00 00 00 01 00 00 00 08 00 00 00 02 00 00 00 00 00 00 00 02 00 00 00 01 00 00 00 08 00 00 00 02 00 00 00 00 00 00 00 02 00 00 00 01 00 00 00 01 00 00 00 0f d6 ff 39 cc 97 07 40 0a d7 a3 70 3d 0a 77 40 0a d7 a3 70 3d 0a 67 40 18 00 00 00 03 00 00 00 01 00 00 00 00 00 00 00 fc a9 f1 d2 4d 62 10 40 02 00 00 00 01 00 00 00 00 00 00 00 01 00 00 00 00 00 00 00 01 00 00 00 00 00 00 00 01 00 00 00 00 00 00 00 01 00 00 00 08 00 00 00 02 00 00 00 00 00 00 00 02 00 00 00 01 00 00 00 08 00 00 00 02 00 00 00 00 00 00 00 02 00 00 00 01 00 00 00 08 00 00 00 02 00 00 00 00 00 00 00 02 00 00 00 01 00 00 00 08 00 00 00 02 00 00 00 00 00 00 00 02 00 00 00 01 00 00 00 01 00 00 00 0f d6 ff 39 cc 97 07 40 0a d7 a3 70 3d 0a 77 40 0a d7 a3 70 3d 0a 67 40 18 00 00 00 03 00 00 00 01 00 00 00 00 00 00 00 fc a9 f1 d2 4d 62 10 40 02 00 00 00 01 00 00 00 00 00 00 00 01 00 00 00 00 00 00 00 01 00 00 00 00 00 00 00 01 00 00 00 00 00 00 00 01 00 00 00 08 00 00 00 02 00 00 00 00 00 00 00 02 00 00 00 01 00 00 00 08 00 00 00 02 00 00 00 00 00 00 00 02 00 00 00 01 00 00 00 08 00 00 00 02 00 00 00 00 00 00 00 02 00 00 00 01 00 00 00 08 00 00 00 02 00 00 00 00 00 00 00 02 00 00 00];
  reg = <0x00000010 0x00100000 0x0 0x40000>;
 };

 rfdc_regs: uio@1000140000 {
  status = "okay";
  compatible = "usrp-uio";
  reg = <0x10 0x00140000 0x0 0x20000>;
  reg-names = "rfdc-regs";
 };
};
# 20 "/home/wfife/hdd/repos/rfnoc-oot-blocks-dev/build-fpga/build-x420_1000_aurora_C2_UHD_4.10/device_tree.dts" 2

# 1 "/home/wfife/hdd/repos/uhddev/ettus3/fpga/usrp3/top/x400/dts/x4xx-dma.dtsi" 1
/*
 * Copyright 2021 Ettus Research, a National Instruments Brand
 *
 * SPDX-License-Identifier: LGPL-3.0-or-later
 */

&fpga_full {
 #address-cells = <2>;
 #size-cells = <2>;

 misc_clk_3: misc_clk_3 {
  #clock-cells = <0>;
  clock-frequency = <200000000>;
  compatible = "fixed-clock";
 };

 // AXI DMA engine + control
 nixge_internal: ethernet@10000A4000 {
  compatible = "ni,xge-enet-3.00";
  reg = <0x10 0x000A4000 0x0 0x4000
         0x10 0x000A8000 0x0 0x2000>;
  reg-names = "dma", "ctrl";

  clocks = <&misc_clk_3>;
  clock-names = "bus_clk";

  interrupts = <0 104 4 0 105 4>;
  interrupt-names = "tx", "rx";
  interrupt-parent = <&gic>;

  status = "okay";

  phy-mode = "internal";
  local-mac-address = <0x00 0x01 0x02 0x03 0x04 0x05>;

  fixed-link {
   speed = <1000>;
   full-duplex;
  };
 };

 // Misc internal Ethernet registers
 uio@10000AA000 {
  compatible = "usrp-uio";
  reg = <0x10 0x000AA000 0x0 0x2000>;
  reg-names = "misc-enet-int-regs";
  status = "okay";
 };

};
# 22 "/home/wfife/hdd/repos/rfnoc-oot-blocks-dev/build-fpga/build-x420_1000_aurora_C2_UHD_4.10/device_tree.dts" 2
